## config/Kconfig
```kconfig
menuconfig ZMK_STUDIO_RPC_UART
   bool "Enable Studio RPC UART"
   select UART_INTERRUPT_DRIVEN
   select UART_LINE_CTRL
   default n
```

## config/west.yml
```yaml
manifest:
  remotes:
    - name: zmkfirmware
      url-base: https://github.com/zmkfirmware
    # Additional modules containing boards/shields/custom code can be listed here as well
    # See https://docs.zephyrproject.org/3.2.0/develop/west/manifest.html#projects
  projects:
    - name: zmk
      remote: zmkfirmware
      revision: main
      import: app/west.yml
    - name: zmk-studio
      url: https://github.com/zmkfirmware/zmk-studio.git
      revision: main
      path: app/zmk-studio
  self:
    path: config
```
